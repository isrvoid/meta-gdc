## conf/layer.conf
```bitbake
# We have a conf and classes directory, add to BBPATH
BBPATH .= ":${LAYERDIR}"

# We have recipes-* directories, add to BBFILES
BBFILES += "${LAYERDIR}/recipes-*/*/*.bb \
	${LAYERDIR}/recipes-*/*/*.bbappend"

BBFILE_COLLECTIONS += "meta-gdc"
BBFILE_PATTERN_meta-gdc = "^${LAYERDIR}/"
BBFILE_PRIORITY_meta-gdc = "6"

export GDC = "${CCACHE}${HOST_PREFIX}gdc ${HOST_CC_ARCH}${TOOLCHAIN_OPTIONS}"
export BUILD_GDC = "${CCACHE}${BUILD_PREFIX}gdc ${BUILD_CC_ARCH}"

export BUILD_GDCFLAGS = "${BUILD_CFLAGS}"
export GDCFLAGS = "${TARGET_GDCFLAGS}"
export TARGET_GDCFLAGS = "${TARGET_CFLAGS}"
```
